## sg-ext/Config.in
```kconfig
menu "Secure Graphics Buildroot External"

source "$BR2_EXTERNAL_SG_EXT_PATH/package/optee_client_ext/Config.in"
source "$BR2_EXTERNAL_SG_EXT_PATH/package/optee_os_artifacts_ext/Config.in"
source "$BR2_EXTERNAL_SG_EXT_PATH/package/optee_test_ext/Config.in"

source "$BR2_EXTERNAL_SG_EXT_PATH/package/sg-tee-test/Config.in"
source "$BR2_EXTERNAL_SG_EXT_PATH/package/sg-tee-abi-test/Config.in"

source "$BR2_EXTERNAL_SG_EXT_PATH/package/sg-drm-info/Config.in"
source "$BR2_EXTERNAL_SG_EXT_PATH/package/sg-drm-dump/Config.in"
source "$BR2_EXTERNAL_SG_EXT_PATH/package/sg-drm-modeset/Config.in"
source "$BR2_EXTERNAL_SG_EXT_PATH/package/sg-drm-atomic-modeset/Config.in"

endmenu
```

## sg-ext/package/optee_os_artifacts_ext/Config.in
```kconfig
config BR2_PACKAGE_OPTEE_OS_ARTIFACTS_EXT
	bool "optee_os_artifacts"

config BR2_PACKAGE_OPTEE_OS_ARTIFACTS_EXT_SITE
	string "OPTEE Exported TA Directory"
	default ""
```

## sg-ext/package/sg-drm-atomic-modeset/Config.in
```kconfig
config BR2_PACKAGE_SG_DRM_ATOMIC_MODESET
	bool "sg-drm-atomic-modeset"
	select BR2_PACKAGE_LIBDRM
	help
		Secure Graphics DRM Information Utility(drm-test-app)
```

## sg-ext/package/sg-drm-dump/Config.in
```kconfig
config BR2_PACKAGE_SG_DRM_DUMP
	bool "sg-drm-dump"
	select BR2_PACKAGE_LIBDRM
	help
		Secure Graphics DRM Information Utility(drm-test-app)
```

## sg-ext/package/sg-drm-info/Config.in
```kconfig
config BR2_PACKAGE_SG_DRM_INFO
	bool "sg-drm-info"
	select BR2_PACKAGE_LIBDRM
	help
		Secure Graphics DRM Information Utility(drm-test-app)
```

## sg-ext/package/sg-drm-modeset/Config.in
```kconfig
config BR2_PACKAGE_SG_DRM_MODESET
	bool "sg-drm-modeset"
	select BR2_PACKAGE_LIBDRM
	help
		Secure Graphics DRM Information Utility(drm-test-app)
```

## sg-ext/package/sg-tee-abi-test/Config.in
```kconfig
config BR2_PACKAGE_SG_TEE_ABI_TEST
	bool "sg-tee-abi-test"
	select BR2_PACKAGE_OPTEE_CLIENT_EXT
	help
		Secure Graphics REE <-> TEE ABI Harness Test

if BR2_PACKAGE_SG_TEE_TEST

config BR2_PACKAGE_SG_TEE_ABI_TEST_TA_DEV_KIT
	string "OP-TEE TA Development Kit Path"
	help
		Path to the  OP-TEE exported development kit path.

		This directory is normally "/out/optee/export-ta_arm64"
		in our setup

endif
```

## sg-ext/package/sg-tee-test/Config.in
```kconfig
config BR2_PACKAGE_SG_TEE_TEST
	bool "sg-tee-test"
	select BR2_PACKAGE_OPTEE_CLIENT_EXT
	help
		Secure Graphics REE <-> TEE Communication Test

if BR2_PACKAGE_SG_TEE_TEST

config BR2_PACKAGE_SG_TEE_TEST_TA_DEV_KIT
	string "OP-TEE TA Development Kit Path"
	help
		Path to the  OP-TEE exported development kit path.

		This directory is normally "/out/optee/export-ta_arm64"
		in our setup

endif
```
